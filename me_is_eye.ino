// ME is eye
// taniguchi kotaro
// https://www.youtube.com/channel/UCBqoH73F31mbhyLkG3wj1HA

#include <Arduboy2.h>

Arduboy2 display;

void setup() {
  display.begin();
}

// http://fuopy.github.io/arduboy-image-converter/

PROGMEM const unsigned char bitmap_eye [][8*128] = {
{
0x00, 0x00, 0x00, 0x00, 0x00, 0x00, 0x00, 0x00, 
0x00, 0x00, 0x00, 0x00, 0x00, 0x00, 0x00, 0x00, 
0x00, 0x00, 0x00, 0x00, 0x00, 0x00, 0x00, 0x00, 
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0x00, 0x00, 0x00, 0x00, 0x00, 0x00, 0x00, 0x00, 

},
{
0x00, 0x00, 0x00, 0x00, 0x00, 0x00, 0x00, 0x00, 
0x00, 0x00, 0x00, 0x00, 0x00, 0x00, 0x00, 0x00, 
0x00, 0x00, 0x00, 0x00, 0x00, 0x00, 0x00, 0x00, 
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0x00, 0x00, 0x00, 0x00, 0x00, 0x00, 0x00, 0x00, 
},
{
0x00, 0x00, 0x00, 0x00, 0x00, 0x00, 0x00, 0x00, 
0x00, 0x00, 0x00, 0x00, 0x00, 0x00, 0x00, 0x00, 
0x00, 0x00, 0x00, 0x00, 0x00, 0x00, 0x00, 0x00, 
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0x00, 0x00, 0x00, 0x00, 0x00, 0x00, 0x00, 0x00, 

},
{
0x00, 0x00, 0x00, 0x00, 0x00, 0x00, 0x00, 0x00, 
0x00, 0x00, 0x00, 0x00, 0x00, 0x00, 0x00, 0x00, 
0x00, 0x00, 0x00, 0x00, 0x00, 0x00, 0x00, 0x00, 
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0x00, 0x00, 0x00, 0x00, 0x00, 0x00, 0x00, 0x00, 
},
};



PROGMEM const unsigned char bitmap_eye_option [][8*128] = {
{
0x00, 0x00, 0x00, 0x00, 0x00, 0x00, 0x00, 0x00, 
0x00, 0x00, 0x00, 0x00, 0x00, 0x00, 0x00, 0x00, 
0x00, 0x00, 0x00, 0x00, 0x00, 0x00, 0x00, 0x00, 
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0x00, 0x00, 0x00, 0x00, 0x00, 0x00, 0x00, 0x00, 
},
{
0x00, 0x00, 0x00, 0x00, 0x00, 0x00, 0x00, 0x00, 
0x00, 0x00, 0x00, 0x00, 0x00, 0x00, 0x00, 0x00, 
0x00, 0x00, 0x00, 0x00, 0x00, 0x00, 0x00, 0x00, 
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0x00, 0x00, 0x00, 0x00, 0x00, 0x00, 0x00, 0x00, 
},
};
unsigned long currTime;
unsigned long prevTime = 0;
#define FPSDELAY      1000/30
int count_blink = 0;

enum {
  eye_sirome = 0,
  eye_normal = 1,
  eye_hanme = 2,
  eye_tsumuru = 3,
} eye_state = eye_normal, eye_contol = eye_normal, eye_button = eye_normal;

enum {
  eye_heart = 0,
  eye_kirakira = 1,
  eye_none = 2,
} eye_option = eye_none;

bool now_push = false;
bool now_push_a = false;
bool now_push_b = false;

void loop() {
  while (true) {
    currTime = millis();
    if ( currTime > prevTime + FPSDELAY ) {
      prevTime = currTime;
      byte input = display.buttonsState();
      count_blink++;
      if (count_blink > 160) {
        count_blink = 0;
      } else if (count_blink > 155) {
        eye_contol = eye_tsumuru;
      } else if (count_blink > 150) {
        eye_contol = eye_normal;
      } else {
        eye_contol = eye_button;
      }
      if (input & (UP_BUTTON |DOWN_BUTTON)) {
        if (!now_push) {
          if (input & UP_BUTTON) {
            switch (eye_button) {
              case eye_normal:  eye_button = eye_sirome; break;
              case eye_tsumuru: eye_button = eye_normal; break;
            }
          }
          if (input & DOWN_BUTTON) {
            switch (eye_button) {
              case eye_sirome:  eye_button = eye_normal;  break;
              case eye_normal:  eye_button = eye_tsumuru; break;
            }
          }
          now_push = true;
        }
        count_blink = 0;
      } else {
        now_push = false;
      }

      if (input & A_BUTTON) {
        if (!now_push_a) {
          now_push_a = true;
          if (eye_state == eye_normal) eye_option = eye_kirakira;
        }
        count_blink = 0;
      } else {
        now_push_a = false;
      }
      if (input & B_BUTTON) {
        if (!now_push_b) {
          now_push_b = true;
          if (eye_state == eye_normal) eye_option = eye_heart;
        }
        count_blink = 0;
      } else {
        now_push_b = false;
      }

      if (eye_state < eye_contol) {
        switch (eye_state) {
          case eye_sirome: eye_state  = eye_normal;  break;
          case eye_normal: eye_state  = eye_hanme; 
                           eye_option = eye_none;    break;
          case eye_hanme:  eye_state  = eye_tsumuru; break;
        }
      } else if (eye_state > eye_contol) {
        switch (eye_state) {
          case eye_normal:  eye_state  = eye_sirome;
                            eye_option = eye_none;   break;
          case eye_hanme:   eye_state  = eye_normal; break;
          case eye_tsumuru: eye_state  = eye_hanme;  break;
        }
      }
      display.clear();
      display.drawBitmap(0, 0, bitmap_eye[eye_state], 128,64,1);
      if (eye_option != eye_none) {
        display.drawBitmap(0, 0, bitmap_eye_option[eye_option], 128,64,1);
      }
      display.display();
    }
  }
}

